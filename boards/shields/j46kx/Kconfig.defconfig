## boards/shields/j46kx/Kconfig.defconfig
```kconfig
if SHIELD_J46KX_LEFT

config ZMK_KEYBOARD_NAME
    default "J46Kx"

config ZMK_SPLIT_ROLE_CENTRAL
    default y

endif

if SHIELD_J46KX_LEFT || SHIELD_J46KX_RIGHT

config ZMK_SPLIT 
    default y

endif
```

## boards/shields/j46kx/Kconfig.shield
```kconfig
config SHIELD_J46KX_LEFT
    def_bool $(shields_list_contains,j46kx_left)

config SHIELD_J46KX_RIGHT
    def_bool $(shields_list_contains,j46kx_right)
```

## boards/shields/j46kxv2/Kconfig.defconfig
```kconfig
if SHIELD_J46KXV2_LEFT

config ZMK_KEYBOARD_NAME
    default "J46KxV2"

config ZMK_SPLIT_ROLE_CENTRAL
    default y

endif

if SHIELD_J46KXV2_LEFT || SHIELD_J46KXV2_RIGHT

config ZMK_SPLIT 
    default y

endif
```

## boards/shields/j46kxv2/Kconfig.shield
```kconfig
config SHIELD_J46KXV2_LEFT
    def_bool $(shields_list_contains,j46kxv2_left)

config SHIELD_J46KXV2_RIGHT
    def_bool $(shields_list_contains,j46kxv2_right)
```
