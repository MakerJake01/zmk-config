#include "j46kxv2.dtsi"

&xiao_serial { status = "disabled"; };

&kscan0{
    col-gpios
			= <&shifter 2 (GPIO_ACTIVE_HIGH)>
			, <&shifter 3 (GPIO_ACTIVE_HIGH)>
			, <&shifter 4 (GPIO_ACTIVE_HIGH)>
			, <&shifter 5 (GPIO_ACTIVE_HIGH)>
			, <&shifter 6 (GPIO_ACTIVE_HIGH)>
			, <&shifter 7 (GPIO_ACTIVE_HIGH)>
			;
};

&xiao_spi {
    status = "okay";
    cs-gpios = <&xiao_d 7 GPIO_ACTIVE_LOW>;
    shifter: 595@0 {
        compatible = "zmk,gpio-595";
        status = "okay";
        gpio-controller;
        spi-max-frequency = <200000>;
        reg = <0>;
        #gpio-cells = <2>;
        ngpios = <8>;
    };
};